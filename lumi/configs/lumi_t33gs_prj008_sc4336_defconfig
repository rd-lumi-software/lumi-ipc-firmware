## lumi/configs/lumi_t33gs_prj008_sc4336_defconfig
```kconfig
# PRJ008 kernel/modules are managed by the vendor platform package.
BR2_mipsel=y
BR2_mips_xburst=y
# Match the downloaded OpenIPC sysroot's hard-float libc and loader.
# BR2_MIPS_SOFT_FLOAT is not set
BR2_MIPS_FP32_MODE_32=y
BR2_TOOLCHAIN_EXTERNAL=y
BR2_TOOLCHAIN_EXTERNAL_CUSTOM=y
BR2_TOOLCHAIN_EXTERNAL_DOWNLOAD=y
BR2_TOOLCHAIN_EXTERNAL_URL="https://github.com/openipc/firmware/releases/download/toolchain/toolchain.ingenic-t31.tgz"
BR2_TOOLCHAIN_EXTERNAL_CUSTOM_PREFIX="mipsel-openipc-linux-musl"
BR2_TOOLCHAIN_EXTERNAL_HEADERS_3_10=y
BR2_TOOLCHAIN_EXTERNAL_CUSTOM_MUSL=y
BR2_TOOLCHAIN_EXTERNAL_CXX=y
# BR2_LINUX_KERNEL is not set
BR2_OPTIMIZE_S=y
BR2_SSP_REGULAR=y
BR2_RELRO_PARTIAL=y
BR2_PER_PACKAGE_DIRECTORIES=y
BR2_TARGET_GENERIC_HOSTNAME="lumi"
BR2_TARGET_GENERIC_ISSUE="Welcome to Lumi"
BR2_PACKAGE_BUSYBOX_CONFIG="$(BR2_EXTERNAL_GENERAL_PATH)/package/busybox/busybox.config"
BR2_ROOTFS_OVERLAY="$(BR2_EXTERNAL_GENERAL_PATH)/overlay $(BR2_EXTERNAL_LUMI_PATH)/overlay $(BR2_EXTERNAL_LUMI_PATH)/board/t33gs-prj008/overlay"
BR2_GLOBAL_PATCH_DIR="$(BR2_EXTERNAL_GENERAL_PATH)/package/all-patches $(BR2_EXTERNAL_LUMI_PATH)/package/all-patches"
BR2_TARGET_ROOTFS_SQUASHFS=y
BR2_TARGET_ROOTFS_SQUASHFS4_XZ=y
BR2_TARGET_ROOTFS_SQUASHFS_BS_1024K=y
BR2_PACKAGE_HOST_UBOOT_TOOLS=y
BR2_PACKAGE_HOST_UBOOT_TOOLS_FIT_SUPPORT=y
BR2_PACKAGE_UBOOT_TOOLS=y
BR2_PACKAGE_UBOOT_TOOLS_FWPRINTENV=y
BR2_PACKAGE_HOST_KMOD=y
BR2_PACKAGE_DROPBEAR_OPENIPC=y
BR2_PACKAGE_DOSFSTOOLS=y
BR2_PACKAGE_DOSFSTOOLS_FSCK_FAT=y
BR2_PACKAGE_IPTABLES=y
BR2_PACKAGE_IW=y
BR2_PACKAGE_WIRELESS_TOOLS=y
BR2_PACKAGE_WPA_SUPPLICANT=y
BR2_PACKAGE_WPA_SUPPLICANT_CLI=y
BR2_PACKAGE_WPA_SUPPLICANT_PASSPHRASE=y
BR2_OPENIPC_SOC_VENDOR="ingenic"
BR2_OPENIPC_SOC_MODEL="t33"
BR2_OPENIPC_SOC_FAMILY="t33"
BR2_OPENIPC_SNS_MODEL="sc4336"
BR2_OPENIPC_VARIANT="lite"
BR2_OPENIPC_FLASH_SIZE="16"

BR2_PACKAGE_LUMI_T33_PLATFORM=y
BR2_PACKAGE_LUMI_T33_RUNTIME=y
BR2_PACKAGE_LUMI_T33_VOICE=y
BR2_ROOTFS_POST_BUILD_SCRIPT="$(BR2_EXTERNAL_GENERAL_PATH)/scripts/rootfs_script.sh $(BR2_EXTERNAL_LUMI_PATH)/scripts/post-build.sh $(BR2_EXTERNAL_LUMI_PATH)/board/t33gs-prj008/post-build.sh"
BR2_ROOTFS_POST_IMAGE_SCRIPT="$(BR2_EXTERNAL_LUMI_PATH)/board/t33gs-prj008/post-image.sh"

# Gateway is already stripped; retain the ELF bound to its crypto build receipt.
BR2_STRIP_EXCLUDE_FILES="ipc-stream-services"
```

## lumi/package/lumi-t33-platform/Config.in
```kconfig
config BR2_PACKAGE_LUMI_T33_PLATFORM
	bool "Lumi T33 PRJ008 SDK platform (4.4.94)"
	depends on BR2_mipsel
	select BR2_PACKAGE_HOST_UBOOT_TOOLS
	select BR2_PACKAGE_HOST_KMOD
	select BR2_PACKAGE_LUMI_T33_UBOOT
	help
	  Build the PRJ008 kernel and SDK modules with the vendor GCC 5.4
	  toolchain. Sources and toolchains are provided by the pinned workspace.
	  Source revisions and SDK checksums are recorded in the build manifest.

config BR2_PACKAGE_LUMI_T33_RUNTIME
	bool "Lumi T33 compact camera runtime"
	depends on BR2_PACKAGE_LUMI_T33_PLATFORM
	help
	  Build the compact runtime from the pinned lumi-ipc-streamer source,
	  including relay, recorder and snapshot dependencies.
	  https://github.com/rd-lumi-software/lumi-ipc-streamer

config BR2_PACKAGE_LUMI_T33_VOICE
	bool "Lumi T33 voice worker"
	depends on BR2_PACKAGE_LUMI_T33_RUNTIME
	default y

config BR2_PACKAGE_LUMI_T33_UBOOT
	bool
```
